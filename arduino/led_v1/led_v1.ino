
#include "SPI.h"
//**************************************************************//
//  Name    : MingMing LED                            
//  Author  : wendal chen 
//  Date    : 2014/08/23    
//  Modified: 2014/08/25                                 
//  Version : 1.0                        
//****************************************************************

//Pin connected to ST_CP of 74HC595
int latchPin = 8;
//Pin connected to SH_CP of 74HC595
int clockPin = 12;
////Pin connected to DS of 74HC595
int dataPin  = 11;

int aPin     = 4;
int bPin     = 7;

byte DATA[46][16] ={ 


{0xFB,0xFB,0xFB,0xFB,0xFB,0x83,0xFB,0xFB,0xFB,0xFB,0xFB,0xFB,0xE3,0x1B,0xBB,0xFB},
{0xBF,0xBF,0xBF,0xBB,0xB7,0xAF,0x9F,0xBF,0xBF,0xBF,0xBF,0xBD,0xBD,0xBD,0xC1,0xFF},/*"北",0*/
{0xFD,0xFE,0x00,0xFF,0xFF,0xE0,0xEF,0xEF,0xEF,0xE0,0xFE,0xEE,0xEE,0xDE,0xBA,0xFD},
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{0xFF,0xFF,0xFF,0x11,0x93,0x93,0x93,0x93,0xAB,0xAB,0xAB,0xAB,0xAB,0x29,0xFF,0xFF},/*"M",35*/

};

int CNF_SCREEN_W = 3*32;
int CNF_SCREEN_H = 1*16;
int CNF_SCREEN_W_POINT = 8;
int DATA_Column_COUNT = 46;
int CNF_LINE_SCAN = 4;
int CNF_FRAME_STILL = 5;
int CNF_USE_SPI = 1;
int CNF_USE_MM_LED = 0;


void setup() {
  if (CNF_USE_MM_LED == 0) {
    pinMode(latchPin, OUTPUT);
    pinMode(aPin, OUTPUT);
    pinMode(bPin, OUTPUT);
  }
  if (CNF_USE_SPI != 0) {
    SPI.begin();
    SPI.setBitOrder(MSBFIRST);
    } else {
      pinMode(clockPin, OUTPUT);
      pinMode(dataPin, OUTPUT);
    }
  }

void send(byte b) {
    if (CNF_USE_SPI!=0) {
      SPI.transfer(b);
    } else {
      shiftOut(dataPin, clockPin, MSBFIRST, b);
    }
  }

void clear() {
  // clear 74HC959 status
  digitalWrite(latchPin, LOW);
  for(int i=0; i<DATA_Column_COUNT; i++){
    for(int z=0; z<CNF_LINE_SCAN; z++){
      send(0xFF);
    }
  }
  digitalWrite(latchPin, HIGH);
}

void lock_and_display(byte A, byte B) {
  if (CNF_USE_MM_LED) {
    ;
  } else {
    digitalWrite(aPin, A);
    digitalWrite(bPin, B);
    digitalWrite(latchPin, HIGH);
  }
}

void loop() {
  byte d = 0;
  int y = 0;
  int q = 0;
  int P = 0;
  int L = 0;
  int SCREEN_TOTLE_COLUMN = CNF_SCREEN_W / CNF_SCREEN_W_POINT;
  for(int offset=0; offset<DATA_Column_COUNT*8; offset++){
  //for(int offset=DATA_Column_COUNT*8; offset>0; offset--){
    for(int t=0; t<CNF_FRAME_STILL; t++){      
      for(int j=0; j<(CNF_SCREEN_H/CNF_LINE_SCAN); j++){ // SCAN TIMES
        //clear();
        delay(2);
        digitalWrite(latchPin, LOW);
        for(int p=0; p<SCREEN_TOTLE_COLUMN; p++){
          for(int z=CNF_LINE_SCAN; z>0; z--){
            y = offset / CNF_SCREEN_W_POINT;
            q = offset % CNF_SCREEN_W_POINT;
            P = y + p;
            L = z*CNF_LINE_SCAN - ((CNF_SCREEN_H / CNF_LINE_SCAN)-j);
            if (P >= DATA_Column_COUNT) {
              P = P - DATA_Column_COUNT;
            }
            if (P >= DATA_Column_COUNT) {
              d = 0xFF;
            } else {
              d = DATA[P][L];
              if (q != 0) {
                d = d << q;
                if (P+1==DATA_Column_COUNT) { // last data
                  d = d ^ (0xFF << q);
                  d = ~ d;
                } else {
                  byte _d = ((DATA[P+1][L] >> 1) & 0x7F) >> (8 - q - 1);
                  d = d | _d;
                }
              }
            }
            send(d);
          }
        }
        lock_and_display(j % 2 == 0 ? LOW : HIGH, (j >> 1) % 2 == 0 ? LOW : HIGH);
      }
    }
  }
}